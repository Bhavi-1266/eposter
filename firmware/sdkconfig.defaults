## firmware/sdkconfig.defaults
```kconfig
CONFIG_PARTITION_TABLE_CUSTOM=y
CONFIG_PARTITION_TABLE_CUSTOM_FILENAME="partitions.csv"
CONFIG_ESPTOOLPY_FLASHSIZE_4MB=y
CONFIG_ESPTOOLPY_FLASHFREQ_40M=y
CONFIG_FREERTOS_HZ=1000
CONFIG_BOOTLOADER_LOG_LEVEL_WARN=y
CONFIG_ESP_MAIN_TASK_STACK_SIZE=6144
```
